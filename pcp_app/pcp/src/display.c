#include "display.h"

#include <zephyr/kernel.h>

#if DT_HAS_CHOSEN(display)
#include <zephyr/device.h>
#include <zephyr/drivers/display.h>

#include <zephyr/display/cfb.h>
#include <zephyr/drivers/display.h>

#include "tasks.h"
#include "critical_section.h"

#define SSD1306 DT_CHOSEN(display)
static const struct device *dev = DEVICE_DT_GET(SSD1306);

static const uint32_t icon_width = 40;
static const uint32_t icon_height = 40;

int ssd1306_setup(void)
{
	if (!device_is_ready(dev)) {
		printf("ERROR: Display device not ready");
		return -EIO;
	}

	if (display_set_pixel_format(dev, PIXEL_FORMAT_MONO01)) {
		printf("ERROR: Failed to set required pixel format");
		return -EIO;
	}

	if (display_blanking_off(dev)) {
		printf("ERROR: Failed to turn off display blanking");
		return -EIO;
	}

	if (cfb_framebuffer_init(dev)) {
		printf("ERROR: Failed to initialize character framebuffer");
		return -EIO;
	}
	cfb_framebuffer_invert(dev);
	cfb_framebuffer_clear(dev, true);
	return 0;
}
SYS_INIT(ssd1306_setup, APPLICATION, CONFIG_KERNEL_INIT_PRIORITY_DEVICE);

/* @brief Draw bitmap
 *
 * @param dev	  pointer to device structure for driver instance
 * @param bitmap  bitmap of size 40x40
 *
 * @return 0 on success, negative value otherwise
 */
int cfb_draw_bitmap(const struct device *dev, const unsigned char *bitmap,
		    struct cfb_position offset)
{
	struct cfb_position pos;
	uint16_t byteWidth = icon_width / 8;
	for (pos.y = 0; pos.y < icon_height; pos.y++) {
		for (pos.x = 0; pos.x < icon_width; pos.x++) {
			if (bitmap[pos.y * byteWidth + pos.x / 8] & (128 >> (pos.x & 7))) {
				struct cfb_position pos_display = {
					.x = pos.x + offset.x,
					.y = pos.y + offset.y,
				};
				cfb_draw_point(dev, &pos_display);
			}
		}
	}

	return 0;
}

const unsigned char bitmap_x[] = {
	0x00, 0x00, 0x00, 0x00, 0x00, 0x00, 0x00, 0x00, 0x00, 0x00, 0x00, 0x00, 0x00, 0x00, 0x00,
	0x00, 0x00, 0x00, 0x00, 0x00, 0x00, 0xe0, 0x00, 0x01, 0x80, 0x01, 0xf0, 0x00, 0x07, 0xe0,
	0x03, 0xf8, 0x00, 0x0f, 0xf0, 0x07, 0xfc, 0x00, 0x3f, 0xf8, 0x0f, 0xfe, 0x00, 0x7f, 0xf8,
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	0x00, 0x00, 0x00, 0x00, 0x00};

const unsigned char bitmap_coffee[] = {
	0x00, 0x00, 0x00, 0x00, 0x00, 0x00, 0x00, 0x00, 0x00, 0x00, 0x00, 0x00, 0x00, 0x00, 0x00,
	0x00, 0x00, 0x00, 0x00, 0x00, 0x00, 0x00, 0x00, 0x00, 0x00, 0x00, 0x00, 0x00, 0x00, 0x00,
	0x00, 0x00, 0x00, 0x00, 0x00, 0x00, 0x0f, 0xff, 0xe0, 0x00, 0x00, 0x70, 0x00, 0x1c, 0x00,
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	0x00, 0x00, 0x00, 0x00, 0x00};

const unsigned char bitmap_gear[] = {
	0x00, 0x00, 0x00, 0x00, 0x00, 0x00, 0x00, 0x00, 0x00, 0x00, 0x00, 0x00, 0x3e, 0x00, 0x00,
	0x00, 0x00, 0x7e, 0x00, 0x00, 0x00, 0x00, 0x7f, 0x00, 0x00, 0x00, 0x00, 0x7f, 0x00, 0x00,
	0x00, 0xe0, 0xff, 0x07, 0x00, 0x01, 0xf3, 0xff, 0xcf, 0x80, 0x03, 0xff, 0xff, 0xff, 0xc0,
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	0x00, 0x00, 0x00, 0x00, 0x00};

const unsigned char *bitmaps[] = {bitmap_x, bitmap_coffee, bitmap_gear};

void ssd1306_print_resource()
{
	if (!device_is_ready(dev)) {
		printf("ERROR: Display device not ready");
		printf("Check your wiring or try reconnecting your USB cable");
		return;
	}

	cfb_framebuffer_clear(dev, false);
	STRUCT_SECTION_FOREACH(critical_section_params, cs) {
		if (cs->resource->mutex->owner == cs->task->thread) {
			struct cfb_position offset = {
				.x = 2 + ((cs->resource->id - 1) % 3) * icon_width,
				.y = 12,
			};
			cfb_draw_bitmap(dev, bitmaps[(cs->task->task_id - 1) % 3], offset);
		}
	}

	cfb_framebuffer_finalize(dev);
}

#else

void ssd1306_print_resource()
{
}

#endif
